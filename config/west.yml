## config/west.yml
```yaml
manifest:
  remotes:
    - name: zmkfirmware
      url-base: https://github.com/zmkfirmware
    - name: krikun98
      url-base: https://github.com/krikun98
    - name: ftc
      url-base: https://github.com/ftc
    - name: urob
      url-base: https://github.com/urob
    - name: caksoylar  # LED
      url-base: https://github.com/caksoylar
  projects:
    - name: zmk
      remote: urob
      revision: main
      import: app/west.yml
    - name: zmk-rgbled-widget  # LED
      remote: caksoylar
      revision: main
  self:
    path: config
```
